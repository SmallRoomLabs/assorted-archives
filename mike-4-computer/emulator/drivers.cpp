// *******************************************************************************************************************************
// *******************************************************************************************************************************
//
//		Name:		drivers.cpp
//		Purpose:	Target dependent code
//		Created:	1st September 2015
//		Author:		Paul Robson (paul@robsons.org.uk)
//
// *******************************************************************************************************************************
// *******************************************************************************************************************************

#include "sys_processor.h"
#include "drivers.h"


// *******************************************************************************************************************************
// *******************************************************************************************************************************
//															WINDOWS
// *******************************************************************************************************************************
// *******************************************************************************************************************************

#ifdef WINDOWS

#include "gfx.h"
#include "sys_debug_system.h"

static BYTE8 keyBuffer = 0;

// *******************************************************************************************************************************
//														Initialise Driver
// *******************************************************************************************************************************

void DRVInitialise(void) {
}

// *******************************************************************************************************************************
//													Receive any new key presses
// *******************************************************************************************************************************

BYTE8 DRVGetKeyIfAvailable(void) {
	BYTE8 rv = keyBuffer;
	keyBuffer = 0;
	return rv;
}

// *******************************************************************************************************************************
//														Write to Scopewriter
// *******************************************************************************************************************************

void DRVWriteScopewriter(char *text) {
	DBGXSetScopewriter(text);
}

// *******************************************************************************************************************************
//												Process keys passed through from debugger
// *******************************************************************************************************************************

int DRVProcessDebugKey(int key,int isRunMode) {
	if (key >= 0 && isRunMode != 0) {
		keyBuffer = GFXToASCII(key,1);
	}
	return key;
}

// *******************************************************************************************************************************
//															End of Frame
// *******************************************************************************************************************************

void DRVEndFrame(void) {
}

#endif

// *******************************************************************************************************************************
// *******************************************************************************************************************************
//														ARDUINO
// *******************************************************************************************************************************
// *******************************************************************************************************************************

#ifdef ARDUINO

#include <Arduino.h>
#include <LiquidCrystal.h>
#include <PS2Keyboard.h>
#include "sys_debug_system.h"

const int DataPin = 2;
const int IRQpin =  3;

static PS2Keyboard keyboard;
static LiquidCrystal lcd(9,8,7,6,5,4);
static BYTE8 keyBuffer = 0;

// *******************************************************************************************************************************
//														Initialise Driver
// *******************************************************************************************************************************

void DRVInitialise(void) {
	//Serial.begin(9600);
	keyboard.begin(DataPin,IRQpin);
	lcd.begin(16,2);
}

// *******************************************************************************************************************************
//													Receive any new key presses
// *******************************************************************************************************************************

BYTE8 DRVGetKeyIfAvailable(void) {
	BYTE8 rv = 0;
	if (keyboard.available()) {
		rv = keyboard.read();
		if (rv == PS2_BACKSPACE) rv = 8;				// We expect chr(8) as backspace
		if (rv >= 127) rv = 0;							// Ignore the wierd and wonderful.
	}
	return rv;
}

// *******************************************************************************************************************************
//														Write to Scopewriter
// *******************************************************************************************************************************

void DRVWriteScopewriter(char *text) {
	static char buffer[17];
	buffer[16] = '\0';
	for (BYTE8 n = 0;n < 2;n++) {
		for (BYTE8 x = 0;x < 16;x++) 
			buffer[x] = text[x+n*16];
		lcd.setCursor(0,n);
		lcd.print(buffer);
	}
}

// *******************************************************************************************************************************
//															End of Frame
// *******************************************************************************************************************************

void DRVEndFrame(void) {
}

#endif