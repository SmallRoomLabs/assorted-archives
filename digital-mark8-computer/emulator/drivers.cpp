// *******************************************************************************************************************************
// *******************************************************************************************************************************
//
//		Name:		drivers.cpp
//		Purpose:	Target dependent code
//		Created:	1st September 2015
//		Author:		Paul Robson (paul@robsons.org.uk)
//
// *******************************************************************************************************************************
// *******************************************************************************************************************************

#include "sys_processor.h"
#include "drivers.h"

// *******************************************************************************************************************************
// *******************************************************************************************************************************
//													WINDOWS Interface
// *******************************************************************************************************************************
// *******************************************************************************************************************************

#ifdef WINDOWS

#include "gfx.h"
#include "sys_debug_system.h"

static BYTE8 keyQueue = 0;

// *******************************************************************************************************************************
//												  Initialise the interface
// *******************************************************************************************************************************

void DRVInitialise(void) {
}

// *******************************************************************************************************************************
//											Get any key if pressed from the queue
// *******************************************************************************************************************************

BYTE8 DRVGetNextKey(void) {
	BYTE8 retVal = keyQueue;
	keyQueue = 0;
	return retVal;
}

// *******************************************************************************************************************************
//												 Write to the video memory
// *******************************************************************************************************************************

void DRVWriteDisplay(BYTE8 address,BYTE8 data) {
	DBGXWriteVideoMemory(address,data);
}

// *******************************************************************************************************************************
//													  End of frame code
// *******************************************************************************************************************************

void DRVEndFrame(void) {
}

// *******************************************************************************************************************************
//											Process keystrokes passed from the debugger
// *******************************************************************************************************************************

int DRVProcessDebugKey(int key,int isRuntime) {
	if (isRuntime && key > 0) {
		keyQueue = GFXToASCII(key,1);
	}
	return key;
}

#endif

// *******************************************************************************************************************************
// *******************************************************************************************************************************
//															ARDUINO Code
// *******************************************************************************************************************************
// *******************************************************************************************************************************

#ifdef ARDUINO

#include <Arduino.h>
#include "sys_debug_system.h"
#include <SPI.h>
#include <PS2Keyboard.h>
#include <Wire.h>
#include "SSD1306_OLED.h"

const int DataPin = 2;
const int IRQpin =  3;

static PS2Keyboard keyboard;

SSD1306Simple oled(1);

// *******************************************************************************************************************************
//												  Initialise the interface
// *******************************************************************************************************************************

void DRVInitialise(void) {
	//Serial.begin(9600);
	keyboard.begin(DataPin,IRQpin);
	oled.init();
}

// *******************************************************************************************************************************
//											Get any key if pressed from the queue
// *******************************************************************************************************************************

BYTE8 DRVGetNextKey(void) {
	if (keyboard.available()) {
		BYTE8 newKey = keyboard.read();
		if (newKey == PS2_BACKSPACE) newKey = 8;
		return newKey;
	}
	return 0;
}

// *******************************************************************************************************************************
//												 Write to the video memory
// *******************************************************************************************************************************

void DRVWriteDisplay(BYTE8 address,BYTE8 data) {
	data = data & 0x7F;
	oled.write(address & 0x1F,address >> 5,data);
}

// *******************************************************************************************************************************
//													  End of Frame
// *******************************************************************************************************************************

void DRVEndFrame(void) {
}

#endif